## layers/meta-balena-rk3328/conf/layer.conf
```bitbake
BBPATH .= ":${LAYERDIR}"

BBFILES += "${LAYERDIR}/recipes-*/*/*.bb \
            ${LAYERDIR}/recipes-*/*/*.bbappend"

BBFILE_COLLECTIONS += "balena-rk3328"
BBFILE_PATTERN_balena-rk3328 := "^${LAYERDIR}/"
BBFILE_PRIORITY_balena-rk3328 = "1337"

LAYERSERIES_COMPAT_balena-rk3328 = "kirkstone"

# we do not use Rockchip's old 2017.09 u-boot
# BBMASK += "meta-rockchip/recipes-bsp/u-boot"

# mask BSP patch which fails to apply and which we have no use for
BBMASK += "meta-rockchip/recipes-core/systemd/systemd"
 
```

## layers/meta-balena-rk3328/conf/machine/heltec-m2808.conf
```bitbake
#@TYPE: Machine
#@NAME: Heltec-M2808

require conf/machine/include/soc-family.inc
include conf/machine/include/arm/arch-armv8a.inc

SOC_FAMILY ?= "rk3328"

MACHINE_EXTRA_RRECOMMENDS:append = " \
	${RK_WIFIBT_FIRMWARES} \
	kernel-modules \
"

RK_ISP_VERSION := ""

SERIAL_CONSOLES ?= "115200;ttyFIQ0"
KERNEL_IMAGETYPE ?= "Image"
KBUILD_DEFCONFIG ?= "rockchip_linux_defconfig"
MACHINEOVERRIDES .= ":rockchip"

PREFERRED_PROVIDER_virtual/bootloader ?= "u-boot"

PREFERRED_PROVIDER_virtual/kernel ?= "linux-rockchip"

# Prefer using Rockchip BSP kernel 4.4
#PREFERRED_VERSION_linux-rockchip ?= "4.19%"
#LINUXLIBCVERSION ?= "4.19-custom%"
PREFERRED_VERSION_linux-rockchip ?= "4.4%"
LINUXLIBCVERSION ?= "4.4-custom%"

# Custom kernel might not support newest python
PACKAGECONFIG:remove:pn-perf = "scripting"

PREFERRED_PROVIDER_virtual/xserver ?= "xserver-xorg"
XSERVER ?= " \
	xserver-xorg \
	xf86-video-modesetting \
	xserver-xorg-module-exa \
	"

PREFERRED_PROVIDER_virtual/egl ?= "rockchip-libmali"
PREFERRED_PROVIDER_virtual/libgles1 ?= "rockchip-libmali"
PREFERRED_PROVIDER_virtual/libgles2 ?= "rockchip-libmali"
PREFERRED_PROVIDER_virtual/libgles3 ?= "rockchip-libmali"
PREFERRED_PROVIDER_virtual/libopencl ?= "rockchip-libmali"
PREFERRED_PROVIDER_virtual/libgbm ?= "rockchip-libmali"
PACKAGECONFIG:pn-wayland ?= "${@bb.utils.contains('DISTRO_FEATURES', 'wayland', 'no-egl', '', d)}"

DEPENDS:append:pn-mesa-gl = " rockchip-libmali"

PREFERRED_PROVIDER_virtual/libgl ?= "mesa-gl"
PREFERRED_PROVIDER_virtual/mesa ?= "mesa-gl"

PREFERRED_RPROVIDER_lib32-initd-functions = "lib32-initscripts"

MALI_GPU := "utgard-450"
MALI_VERSION ?= "r7p0"

SERIAL_CONSOLES = "1500000;ttyFIQ0"

RK_USE_COMPRESSED_KERNEL = "0"

KERNEL_DEVICETREE = "rockchip/rk3328-evb.dtb"

UBOOT_MACHINE = "evb-rk3328_defconfig"

RK_WIFIBT_FIRMWARES = " \
	rkwifibt-firmware-ap6256-wifi \
	rkwifibt-firmware-ap6256-bt \
	brcm-tools \
"
```
